
#include "OLED_I2C.h"
#include "STM32_I2C.H"
#include "DataProces.h"

#define OLED_ADDRESS	0x3C //通过调整0R电阻,屏可以0x78和0x7A两个地址 -- 默认0x78

const uchar F6x8[][6] =
{
    { 0x00, 0x00, 0x00, 0x00, 0x00, 0x00 },   //sp0
    { 0x00, 0x00, 0x00, 0x2f, 0x00, 0x00 },   // !1
    { 0x00, 0x00, 0x07, 0x00, 0x07, 0x00 },   // "2
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    { 0x14, 0x14, 0x14, 0x14, 0x14, 0x14 }    // horiz lines91
};

//======================================================
// 128X64OLED液晶底层驱动[8X16]字体库
// 设计者: Guokaiyi
// 描  述: [8X16]西文字符的字模数据 (纵向取模,字节倒序)
// !"#$%&'()*+,-./0123456789:;<=>?@ABCDEFGHIJKLMNOPQRSTUVWXYZ[\]^_`abcdefghijklmnopqrstuvwxyz{|}~
//======================================================
const uchar F8X16[]=
{
    0x00,0x00,0x00,0x00,0x00,0x00,0x00,0x00,0x00,0x00,0x00,0x00,0x00,0x00,0x00,0x00,// 0
    0x00,0x00,0x00,0xF8,0x00,0x00,0x00,0x00,0x00,0x00,0x00,0x33,0x30,0x00,0x00,0x00,//!1
    0x00,0x10,0x0C,0x06,0x10,0x0C,0x06,0x00,0x00,0x00,0x00,0x00,0x00,0x00,0x00,0x00,//"2
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    0x00,0x06,0x01,0x01,0x02,0x02,0x04,0x04,0x00,0x00,0x00,0x00,0x00,0x00,0x00,0x00,//~94
};


//返回0则空闲，1正在写
uchar EEPROM_CheckBusy(void)
{
return(I2C_CheckBusy(OLED_ADDRESS));
}

uchar I2C_WriteByte(uchar REGadds,uchar Wdat)   //写器件数据
{
	uchar i=I2C_SendByte(OLED_ADDRESS,REGadds,Wdat);
	//while(EEPROM_CheckBusy());//等待空闲
	return(i);
}



void OLED_WrCmd(unsigned char I2C_Command)//写命令
{
	I2C_WriteByte(0x00, I2C_Command);
}

void OLED_WrDat(unsigned char I2C_Data)//写数据
{
	I2C_WriteByte(0x40, I2C_Data);
}

void OLED_Init(void)
{
	delay(100); //这里的延时很重要
	
	OLED_WrCmd(0xAE); //display off
	OLED_WrCmd(0x20);	//Set Memory Addressing Mode	
	OLED_WrCmd(0x10);	//00,Horizontal Addressing Mode;01,Vertical Addressing Mode;10,Page Addressing Mode (RESET);11,Invalid
	OLED_WrCmd(0xb0);	//Set Page Start Address for Page Addressing Mode,0-7
	OLED_WrCmd(0xc8);	//Set COM Output Scan Direction
	OLED_WrCmd(0x00); //---set low column address
	OLED_WrCmd(0x10); //---set high column address
	OLED_WrCmd(0x40); //--set start line address
	OLED_WrCmd(0x81); //--set contrast control register
	OLED_WrCmd(0xff); //亮度调节 0x00~0xff
	OLED_WrCmd(0xa1); //--set segment re-map 0 to 127
	OLED_WrCmd(0xa6); //--set normal display
	OLED_WrCmd(0xa8); //--set multiplex ratio(1 to 64)
	OLED_WrCmd(0x3F); //
	OLED_WrCmd(0xa4); //0xa4,Output follows RAM content;0xa5,Output ignores RAM content
	OLED_WrCmd(0xd3); //-set display offset
	OLED_WrCmd(0x00); //-not offset
	OLED_WrCmd(0xd5); //--set display clock divide ratio/oscillator frequency
	OLED_WrCmd(0xf0); //--set divide ratio
	OLED_WrCmd(0xd9); //--set pre-charge period
	OLED_WrCmd(0x22); //
	OLED_WrCmd(0xda); //--set com pins hardware configuration
	OLED_WrCmd(0x12);
	OLED_WrCmd(0xdb); //--set vcomh
	OLED_WrCmd(0x20); //0x20,0.77xVcc
	OLED_WrCmd(0x8d); //--set DC-DC enable
	OLED_WrCmd(0x14); //
	OLED_WrCmd(0xaf); //--turn on oled panel
	
	delay(20);
	ShowClear();
}








/*****************************************************************************
 函 数 名  : LED_SetPos
 功能描述  : 设置坐标
 输入参数  : uchar SX
             uchar SY
 输出参数  : NONE
 返 回 值  : NONE
*****************************************************************************/
void OLED_SetPos(uchar SX, uchar SY)
{
    OLED_WrCmd(0xb0 + SY);
    OLED_WrCmd(((SX & 0xf0) >> 4) | 0x10);
    OLED_WrCmd((SX & 0x0f) | 0x00);
}

/*****************************************************************************
 函 数 名  : LED_Fill
 功能描述  : 对全屏写入同一个字符函数
             如 LED_Fill(0x01);    对于某一位0为不亮 1为亮
            ------------------------------------------------------
                                共128列
                  1           1                1
              共  0           0                0
              8   0           0                0
              组  0       ……0     …………   0
              字  0           0                0
              符  0           0                0
              即  0           0                0
              8   0           0                0
              页  1           1                1
              64  0           0                0
              行  .           .                .
                  .           .    …………    .
                  .           .                .
                  .           .                .
                  0           0                0
            ------------------------------------------------------
 输入参数  : uchar ucData
 输出参数  : NONE
 返 回 值  : NONE
*****************************************************************************/
void OLED_Fill(uchar ucData)
{
    uchar ucPage,ucColumn;

    for(ucPage = 0; ucPage < 8; ucPage++)
    {
        OLED_WrCmd(0xb0 + ucPage);  //0xb0+0~7表示页0~7
        OLED_WrCmd(0x00);           //0x00+0~16表示将128列分成16组其地址在某组中的第几列
        OLED_WrCmd(0x10);           //0x10+0~16表示将128列分成16组其地址所在第几组
        for(ucColumn = 0; ucColumn < 128; ucColumn++)
        {
            OLED_WrDat(ucData);
        }
    }
}


void OLED_FillRam(uchar *ucData)
{
    uchar ucPage,ucColumn;
	  usint cn=0;

    for(ucPage = 0; ucPage < 8; ucPage++)
    {
        OLED_WrCmd(0xb0 + ucPage);  //0xb0+0~7表示页0~7
        OLED_WrCmd(0x00);           //0x00+0~16表示将128列分成16组其地址在某组中的第几列
        OLED_WrCmd(0x10);           //0x10+0~16表示将128列分成16组其地址所在第几组
        for(ucColumn = 0; ucColumn < 128; ucColumn++)
        {
            OLED_WrDat(ucData[cn++]);
        }
    }
}



//--------------------------------------------------------------
// Prototype      : void OLED_ON(void)
// Calls          : 
// Parameters     : none
// Description    : 将OLED从休眠中唤醒
//--------------------------------------------------------------
void OLED_ON(void)
{
	OLED_WrCmd(0X8D);  //设置电荷泵
	OLED_WrCmd(0X14);  //开启电荷泵
	OLED_WrCmd(0XAF);  //OLED唤醒
}

//--------------------------------------------------------------
// Prototype      : void OLED_OFF(void)
// Calls          : 
// Parameters     : none
// Description    : 让OLED休眠 -- 休眠模式下,OLED功耗不到10uA
//--------------------------------------------------------------
void OLED_OFF(void)
{
	OLED_WrCmd(0X8D);  //设置电荷泵
	OLED_WrCmd(0X10);  //关闭电荷泵
	OLED_WrCmd(0XAE);  //OLED休眠
}

/*****************************************************************************
 函 数 名  : OLED_P6x8Char
 功能描述  : 显示一个6x8标准ASCII字符
 输入参数  : uchar SX  显示的横坐标0~122
             uchar SY  页范围0～7
             uchar ucData  显示的字符
 输出参数  : NONE
 返 回 值  : NONE
*****************************************************************************/
void OLED_P6x8Char(uchar ucData,uchar SX, uchar SY)
{
    uchar i, ucDataTmp;

    ucDataTmp = ucData-32;
    if(SX > 122) return;
	if(SY > 7) 	 return;
	
    OLED_SetPos(SX, SY);
    for(i = 0; i < 6; i++)
    {
        OLED_WrDat(F6x8[ucDataTmp][i]);
    }
}

/*****************************************************************************
 函 数 名  : OLED_P6x8Str
 功能描述  : 写入一组6x8标准ASCII字符串
 输入参数  : uchar SX       显示的横坐标0~122
             uchar SY       页范围0～7
             uchar ucDataStr[]  显示的字符串
 输出参数  : NONE
 返 回 值  : NONE
*****************************************************************************/
void OLED_P6x8Str(uchar * ucDataStr,uchar SX, uchar SY)
{
    uchar i, j, ucDataTmp;

    for (j = 0; ucDataStr[j] != '\0'; j++)
    {
        ucDataTmp = ucDataStr[j] - 32;
        if(SX > 122)
        {
            SX = 0;
            SY++;
        }

        OLED_SetPos(SX,SY);

        for(i = 0; i < 6; i++)
        {
            OLED_WrDat(F6x8[ucDataTmp][i]);
        }
        SX += 6;
    }

    return;
}












/*****************************************************************************
 函 数 名  : OLED_P6x8Char
 功能描述  : 显示一个6x8标准ASCII字符
 输入参数  : uchar SX  显示的横坐标0~122
             uchar SY  页范围0～7
             uchar ucData  显示的字符
 输出参数  : NONE
 返 回 值  : NONE
*****************************************************************************/
void OLED_P8x16Char(uchar ucData,uchar SX, uchar SY)
{
    uchar i, ucDataTmp;

    ucDataTmp = ucData-32;
    if(SX > 120) return;
	if(SY > 6) 	 return;
	
    OLED_SetPos(SX, SY);
    for(i = 0; i < 8; i++)
    {
        OLED_WrDat(F8X16[(ucDataTmp << 4) + i]);
    }
	
     OLED_SetPos(SX, SY + 1);
     for(i = 0; i < 8; i++)
     {
        OLED_WrDat(F8X16[(ucDataTmp << 4) + i + 8]);
     }
}



/*****************************************************************************
 函 数 名  : LED_P8x16Str
 功能描述  : 写入一组8x16标准ASCII字符串
 输入参数  : UCHAR8 SX       为显示的横坐标0~120
             UCHAR8 SY       为页范围0～6
             UCHAR8 ucDataStr[]  要显示的字符串
 输出参数  : NONE
 返 回 值  : NONE
*****************************************************************************/
void OLED_P8x16Str(uchar * ucDataStr,uchar SX, uchar SY)
{
    uchar i, j, ucDataTmp;


    for (j = 0; ucDataStr[j] != '\0'; j++)
    {
        ucDataTmp = ucDataStr[j] - 32;
        if(SX > 120)
        {
            SX = 0;
            SY += 2;
        }
        OLED_SetPos(SX, SY);

        for(i = 0; i < 8; i++)
        {
            OLED_WrDat(F8X16[(ucDataTmp << 4) + i]);
        }

        OLED_SetPos(SX, SY + 1);

        for(i = 0; i < 8; i++)
        {
            OLED_WrDat(F8X16[(ucDataTmp << 4) + i + 8]);
        }
        SX += 8;

    }

    return;
}







/*****************************************************************************
 函 数 名  : OLED_PrintIong
 功能描述  : 将一个Iong型数转换成5位数进行显示
 输入参数  : uchar SX ucIdxX的范围为0～120
             uchar SY ucIdxY为页的范围0～7
             int sData  sData为需要转化显示的数值
 输出参数  : none
 返 回 值  : none
*****************************************************************************/

void OLED_PrintLong_6x8(long sData,uchar SX, uchar SY)
{
	uchar inB[10];
	uchar outB[10];
	uchar len,i;
	uchar X;
	uchar cnt=0;
    if(sData < 0)
    {
        OLED_P6x8Char('-',SX,SY);
        sData = -sData;
		SX+=6;
    }

	HEXtoBCD(sData,inB);
	len=lcd_hide0(inB,0,10,outB);

	
	for(i=0;i<len;i++)
	{
		X=SX+6*(cnt++);
		if(X>122)
		{
			cnt=0;
			SX=6;
			X=0;
			SY++;
			if(SY>7) return;
		}
		OLED_P6x8Char(outB[i],X,SY);
		
	}
  return;
}



void OLED_PrintLong_8x16(long sData,uchar SX, uchar SY)
{
	uchar inB[10];
	uchar outB[10];
	uchar len,i;
	uchar X;
	uchar cnt=0;
    if(sData < 0)
    {
        OLED_P8x16Char('-',SX,SY);
        sData = -sData;
		SX+=8;
    }

	HEXtoBCD(sData,inB);
	len=lcd_hide0(inB,0,10,outB);

	for(i=0;i<len;i++)
	{
		X=SX+8*(cnt++);
		if(X>120)
		{
			cnt=0;
			SX=8;
			X=0;
			SY++;
			SY++;
			if(SY>6) return;
		}
		OLED_P8x16Char(outB[i],X,SY);
	}
  return;
}










/*****************************************************************************
 函 数 名  : ShowData,
 功能描述  : 显示数据（long型）
 输入参数  : 
			long sData 需要显示的数值
			uchar Size :显示的数据大小.0:6*8  1:8*12
			uchar SX 显示X轴坐标，范围为0～120
            uchar SY 显示行，范围0～7
             
 输出参数  : none
 返 回 值  : none
*****************************************************************************/

void ShowData(long sData,uchar Size,uchar SX, uchar SY)
{
	if(Size==0)
	OLED_PrintLong_6x8(sData,SX,SY);
	else
	OLED_PrintLong_8x16(sData,SX,SY);
	
}


/*****************************************************************************
 函 数 名  : ShowData,
 功能描述  : 显示数据（long型）
 输入参数  : 
			long sData 需要显示的数值
			uchar Size :显示的数据大小.0:6*8  1:8*12
			uchar SX 显示X轴坐标，范围为0～120
            uchar SY 显示行，范围0～7
             
 输出参数  : none
 返 回 值  : none
*****************************************************************************/

void ShowString(uchar * ucDataStr,uchar Size,uchar SX, uchar SY)
{
	if(Size==0)
	OLED_P6x8Str(ucDataStr,SX,SY);
	else
	OLED_P8x16Str(ucDataStr,SX,SY);
	
}




void ShowClear(void)
{
	OLED_Fill(0);
}



/*****************************************************************************
 函 数 名  : OLED_PrintImage
 功能描述  : 将图像显示出来
 输入参数  : uchar *pucTable     二维图像数组的地址
             uint usRowNum    二维图像的行数1~64
             uint usColumnNum 二维图像的列数1~128
 输出参数  : none
 返 回 值  : none
*****************************************************************************/
void OLED_PrintImage(uchar *pucTable, uint usRowNum, uint usColumnNum)
{
    uchar ucData;
    uint i,j,k,m,n;
    uint usRowTmp;

    m = usRowNum >> 3;   //计算图片行数以8位为一组完整的组数
    n = usRowNum % 8;    //计算分完组后剩下的行数

    for(i = 0; i < m; i++) //完整组行扫描
    {
        OLED_SetPos(0,(uchar)i);
        usRowTmp = i << 3;    //计算当前所在行的下标
        for(j = 0; j < usColumnNum; j++) //列扫描
        {
            ucData = 0;
            for(k = 0; k < 8; k++) //在i组中对这8行扫描
            {
                ucData = ucData >> 1;
                if((pucTable + (usRowTmp + k) * usColumnNum)[j] == LED_IMAGE_WHITE)
                {
                    ucData = ucData | 0x80;
                }

            }
            OLED_WrDat(ucData);
        }
    }

    OLED_SetPos(0,(uchar)i); //设置剩下的行显示的起始坐标
    usRowTmp = i << 3;       //计算当前所在行的下标
    for(j = 0; j < usColumnNum; j++) //列扫描
    {
        ucData = 0;
        for(k = 0; k < n; k++) //对剩下的行扫描
        {
            ucData = ucData >> 1;
            if((pucTable + (usRowTmp + k) * usColumnNum)[j] == LED_IMAGE_WHITE)
            {
                ucData = ucData | 0x80;
            }

        }
        ucData = ucData >> (8 - n);
        OLED_WrDat(ucData);
    }

    return;
}

void OLED_PrintBMP(const uchar *pucTable,uchar wide,uchar high, uchar x, uchar y)
{
uchar i,k;

high=high/8;

    for(k = 0; k < high; k++)
    {
        OLED_SetPos(x, y+k);

        for(i = 0; i < wide; i++)
        {
            OLED_WrDat(pucTable[(usint)wide*k+i]);
        }
    }
}


